## board/alientek/imx6u_mini/Kconfig
```kconfig
if TARGET_ALIENTEK_IMX6U_MINI

config SYS_BOARD
	default "imx6u_mini"

config SYS_VENDOR
	default "alientek"

config SYS_CONFIG_NAME
	default "imx6u_mini"

config IMX_CONFIG
	default "board/alientek/imx6u_mini/imximage.cfg"

config SYS_TEXT_BASE
	default 0x87800000

source "board/freescale/common/Kconfig"

endif
```

## board/freescale/mx6ull_alientek_emmc/Kconfig
```kconfig
if TARGET_MX6ULL_ALIENTEK_EMMC

config SYS_BOARD
	default "mx6ull_alientek_emmc"

config SYS_VENDOR
	default "freescale"

config SYS_CONFIG_NAME
	default "mx6ull_alientek_emmc"

config IMX_CONFIG
	default "board/freescale/mx6ull_alientek_emmc/imximage.cfg"

config SYS_TEXT_BASE
	default 0x87800000
endif
```
